// Written by EmbeddedUser 
// Refer to blog http://www.jaimeferns.in/2016/10/how-to-build-humidity-and-temperature.html
// Youtube Video https://www.youtube.com/watch?v=g-rcEd_2I-w
// Humidity meter with DHT11, Arduino and I2c OLED display
// Now support displaying sensor error and configuring deg C or deg F

#include <DHT.h>
#include "U8glib.h"

// Display defaults to Degree F. TO use metric display,
// comment out next line to display temperature in Degree C,
//#define METRIC

#define DHTPIN 2          // what digital pin we're connected to
// Uncomment whatever type you're using!
//#define DHTTYPE DHT11     // DHT 11
#define DHTTYPE DHT22   // DHT 22  (AM2302), AM2321
#define gasSensor A0
#define rainSensor 4 
//#define DHTTYPE DHT21   // DHT 21 (AM2301)

// Connect pin 1 (on the left) of the sensor to +5V
// NOTE: If using a board with 3.3V logic like an Arduino Due connect pin 1
// to 3.3V instead of 5V!
// Connect pin 2 of the sensor to whatever your DHTPIN is
// Connect pin 4 (on the right) of the sensor to GROUND
// Connect a 10K resistor from pin 2 (data) to pin 1 (power) of the sensor

// Initialize DHT sensor.
// Note that older versions of this library took an optional third parameter to
// tweak the timings for faster processors.  This parameter is no longer needed
// as the current DHT reading algorithm adjusts itself to work on faster procs.
DHT dht(DHTPIN, DHTTYPE);

U8GLIB_SSD1306_128X64 u8g(U8G_I2C_OPT_NO_ACK);  // Display which does not send AC
//U8GLIB_SSD1306_128X64 u8g(U8G_I2C_OPT_NONE|U8G_I2C_OPT_DEV_0);  // I2C / TWI
//U8GLIB_SSD1306_128X64 u8g(U8G_I2C_OPT_DEV_0|U8G_I2C_OPT_NO_ACK|U8G_I2C_OPT_FAST); // Fast I2C / TWI
//U8GLIB_SSD1306_128X64 u8g(U8G_I2C_OPT_NO_ACK);  // Display which does not send AC

const uint8_t logo[] PROGMEM =
{
  0x0, 0x0, 0x0, 0x0, 0x0, 0x0, 0x0, 0x0, 0x0, 0x0, 0x0, 0x0, 0x0, 0x0, 0x0,
  0x0, 0x0, 0x0, 0x0, 0x0, 0x0, 0x0, 0x0, 0x0, 0x0, 0x0, 0x0, 0x0, 0x0, 0x0,
  0x0, 0x0, 0x0, 0x0, 0x0, 0x0, 0x0, 0x0, 0x0, 0x0, 0x0, 0x0, 0x0, 0x0, 0x0,
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  0x0, 0x0, 0x0, 0x0
};

bool first = true;
float hum = 0.0;
float temp = 0.0;
//float hIndex = 0.0;
int gas = 0;
int rain = 0;
bool dht_test(float* hum, float* temp, int* gas);

void setup(void)
{
  Serial.begin(9600);
  dht.begin();
  first = true;

  // assign default color value
  if (u8g.getMode() == U8G_MODE_R3G3B2)
  {
    u8g.setColorIndex(255);     // white
  }
  else if (u8g.getMode() == U8G_MODE_GRAY2BIT)
  {
    u8g.setColorIndex(3);         // max intensity
  }
  else if (u8g.getMode() == U8G_MODE_BW)
  {
    u8g.setColorIndex(1);         // pixel on
  }
  else if (u8g.getMode() == U8G_MODE_HICOLOR)
  {
    u8g.setHiColorByRGB(255, 255, 255);
  }

  // picture loop
  u8g.firstPage();

  do
  {
    u8g.drawBitmapP(0, 0, 16, 64, logo);
  }
  while (u8g.nextPage());

  dht_test(&hum, &temp, &gas);
}
void HumMeter(float* hum, float* temp, int* gas)
{
  u8g.setFont(u8g_font_fub11);
  u8g.setFontRefHeightExtendedText();
  u8g.setDefaultForegroundColor();
  u8g.setFontPosTop();
  u8g.drawStr(4, 0, "Hum %");
  u8g.setPrintPos(80, 0);
//  u8g.print(*hum);
//#ifdef METRIC
  // if metric system, display Celsius
  u8g.drawStr(4, 20, "Temp C");
//#else
  //display Farenheit
  //u8g.drawStr(4, 20, "Temp F");
//#endif

  u8g.setPrintPos(80, 20);
//  u8g.print(*temp);
  u8g.drawStr(4, 40, "Gas PPM");
  u8g.setPrintPos(80, 40);
//  u8g.print(*gas);
}

void loop(void)
{
//  bool result = dht_test(&hum, &temp, &gas);
//
//  if (first)
//  {
//    // skip displaying readings first time, as its stale data.
//    first = false;
//  }
//  else
//  {
//    if(result == false)
//    {
//      u8g.firstPage();
//      do 
//      {
//        // sensor error
//        u8g.setFont(u8g_font_fub11);
//        u8g.setFontRefHeightExtendedText();
//        u8g.setDefaultForegroundColor();
//        u8g.setFontPosTop();
//        u8g.drawStr(10, 30, "Sensor Error");
//      }
//      while (u8g.nextPage());
//    }
//    else
//    {
//      u8g.firstPage();
//      do
//      {
//        HumMeter(&hum, &temp, &gas);
//      }
//      while (u8g.nextPage());
//    }
//  }
}
bool dht_test(float* hum, float* temp,int* gas)
{
  // Wait a few seconds between measurements.
  delay(500);
  *hum = 0;
  *temp = 0;
  //*heatIndex = 0;
  *gas = 0;
  //*rain = 0;
  
  // Reading temperature or humidity takes about 250 milliseconds!
  // Sensor readings may also be up to 2 seconds 'old' (its a very slow sensor)
  float h = dht.readHumidity();
  // Read temperature as Celsius (the default)
  float t = dht.readTemperature();
  // Read temperature as Fahrenheit (isFahrenheit = true)
  float f = dht.readTemperature(true);

  // gas
  int g = analogRead(gasSensor);
  //int r = digitalRead(rainSensor);

  // Check if any reads failed and exit early (to try again).
  if (isnan(h) || isnan(t) || isnan(f))
  {
    Serial.println("Failed to read from DHT sensor!");
    return false;
  }

  // Compute heat index in Fahrenheit (the default)
  //float hif = dht.computeHeatIndex(f, h);
  // Compute heat index in Celsius (isFahreheit = false)
  //float hic = dht.computeHeatIndex(t, h, false);

  Serial.print("Humidity: ");
  Serial.print(h);
  Serial.print(" %\t");
  Serial.print("Temperature: ");
  Serial.print(t);
  Serial.print(" *C\t");
//  Serial.print(f);
//  Serial.print(" *F\t");
 // Serial.print("Heat index: ");
  //Serial.print(hic);
  //Serial.print(" *C\t");
//  Serial.print(hif);
//  Serial.println(" *F");
  Serial.print("Gas: ");
  Serial.print(g);
  Serial.println(" PPM");
  *hum = h;
  *temp = t;
  //*heatIndex = hic;
  *gas = g;
//#ifdef METRIC
//  // metric system, load degree celsius
//  *temp = t;
//  *heatIndex = hic;
//#else
//  *temp = f;
//  *heatIndex = hif;
//#endif
  return true;
}


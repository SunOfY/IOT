#include "SPI.h"
#include "MFRC522.h"

#include <DHT.h>
#include "U8glib.h"

 /* Typical pin layout used: RFID
 * -----------------------------------------------------------------------------------------
 *             MFRC522      Arduino       Arduino   Arduino    Arduino          Arduino
 *             Reader/PCD   Uno/101       Mega      Nano v3    Leonardo/Micro   Pro Micro
 * Signal      Pin          Pin           Pin       Pin        Pin              Pin
 * -----------------------------------------------------------------------------------------
 * RST/Reset   RST          9             5         D9         RESET/ICSP-5     RST
 * SPI SS      SDA(SS)      10            53        D10        10               10
 * SPI MOSI    MOSI         11 / ICSP-4   51        D11        ICSP-4           16
 * SPI MISO    MISO         12 / ICSP-1   50        D12        ICSP-1           14
 * SPI SCK     SCK          13 / ICSP-3   52        D13        ICSP-3           15
 */
 
/* ##NodeMcu##    SDA(SS) D4 (Có Thể Đổi)
                  RST     D3 (Có Thể Đổi)
                  SCK     D5
                  MISO    D6
                  MOSI    D7 */

#define SS_PIN  53  //   RFID
#define RST_PIN 5   //   RFID

#define DHTPIN 2 // CB DHT22
#define DHTTYPE DHT22   // DHT 22  (AM2302), AM2321
#define gasSensor A0 // Gas

DHT dht(DHTPIN, DHTTYPE);

U8GLIB_SSD1306_128X64 u8g(U8G_I2C_OPT_NO_ACK);  // Display which does not send AC

MFRC522 rfid(SS_PIN, RST_PIN);
MFRC522::MIFARE_Key key;

const uint8_t logo[] PROGMEM =
{
  0x0, 0x0, 0x0, 0x0, 0x0, 0x0, 0x0, 0x0, 0x0, 0x0, 0x0, 0x0, 0x0, 0x0, 0x0,
  0x0, 0x0, 0x0, 0x0, 0x0, 0x0, 0x0, 0x0, 0x0, 0x0, 0x0, 0x0, 0x0, 0x0, 0x0,
  0x0, 0x0, 0x0, 0x0, 0x0, 0x0, 0x0, 0x0, 0x0, 0x0, 0x0, 0x0, 0x0, 0x0, 0x0,
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  0x0, 0x0, 0x0, 0x0
};

  int dem;
  
  bool first = true;
  float hum = 0.0;
  float temp = 0.0;
  
  int gas = 0;

bool dht_test(float* hum, float* temp, int* gas);

void setup() {
  
    Serial.begin(9600);
    
    pinMode(3, OUTPUT); // motor cổng
    pinMode(4 ,OUTPUT); // motor cổng

    digitalWrite(3,LOW);
    digitalWrite(4,LOW);

    SPI.begin();
    
    dht.begin();
    
    rfid.PCD_Init();

    first = true;
  
    // assign default color value
    if (u8g.getMode() == U8G_MODE_R3G3B2)
    {
      u8g.setColorIndex(255);     // white
    }
    else if (u8g.getMode() == U8G_MODE_GRAY2BIT)
    {
      u8g.setColorIndex(3);         // max intensity
    }
    else if (u8g.getMode() == U8G_MODE_BW)
    {
      u8g.setColorIndex(1);         // pixel on
    }
    else if (u8g.getMode() == U8G_MODE_HICOLOR)
    {
      u8g.setHiColorByRGB(255, 255, 255);
    }
  
    // picture loop
    u8g.firstPage();
  
    do
    {
      u8g.drawBitmapP(0, 0, 16, 64, logo);
    }
    while (u8g.nextPage());
  
    dht_test(&hum, &temp, &gas);

}

void loop() {
  
   rfidtest();

   bool result = dht_test(&hum, &temp, &gas);
  
    if (first)
    {
      // skip displaying readings first time, as its stale data.
      first = false;
    }
    else
    {
      if(result == false)
      {
        u8g.firstPage();
        do 
        {
          // sensor error
          u8g.setFont(u8g_font_fub11);
          u8g.setFontRefHeightExtendedText();
          u8g.setDefaultForegroundColor();
          u8g.setFontPosTop();
          u8g.drawStr(10, 30, "Sensor Error");
        }
        while (u8g.nextPage());
      }
      else
      {
        u8g.firstPage();
        do
        {
          HumMeter(&hum, &temp, &gas);
        }
        while (u8g.nextPage());
      }
    }
    
    delay(100);
}

bool dht_test(float* hum, float* temp,int* gas)
{
  // Wait a few seconds between measurements.
  delay(500);
  *hum = 0;
  *temp = 0;
  //*heatIndex = 0;
  *gas = 0;
  //*rain = 0;
  
  // Reading temperature or humidity takes about 250 milliseconds!
  // Sensor readings may also be up to 2 seconds 'old' (its a very slow sensor)
  float h = dht.readHumidity();
  // Read temperature as Celsius (the default)
  float t = dht.readTemperature();
  // Read temperature as Fahrenheit (isFahrenheit = true)
  float f = dht.readTemperature(true);

  // gas
  int g = analogRead(gasSensor);
  //int r = digitalRead(rainSensor);

  // Check if any reads failed and exit early (to try again).
  if (isnan(h) || isnan(t) || isnan(f))
  {
    Serial.println("Failed to read from DHT sensor!");
    return false;
  }

  // Compute heat index in Fahrenheit (the default)
  //float hif = dht.computeHeatIndex(f, h);
  // Compute heat index in Celsius (isFahreheit = false)
  //float hic = dht.computeHeatIndex(t, h, false);

  Serial.print("Humidity: ");
  Serial.print(h);
  Serial.print(" %\t");
  Serial.print("Temperature: ");
  Serial.print(t);
  Serial.print(" *C\t");
  Serial.print("Gas: ");
  Serial.print(g);
  Serial.println(" PPM");
  
  *hum = h;
  *temp = t;
  *gas = g;

  return true;
}

void rfidtest()
{
    if (!rfid.PICC_IsNewCardPresent() || !rfid.PICC_ReadCardSerial())
      return;
  
    // Serial.print(F("PICC type: "));
    MFRC522::PICC_Type piccType = rfid.PICC_GetType(rfid.uid.sak);
    // Serial.println(rfid.PICC_GetTypeName(piccType));
  
    // Check is the PICC of Classic MIFARE type
    if (piccType != MFRC522::PICC_TYPE_MIFARE_MINI &&
      piccType != MFRC522::PICC_TYPE_MIFARE_1K &&
      piccType != MFRC522::PICC_TYPE_MIFARE_4K) {
      Serial.println(F("Your tag is not of type MIFARE Classic."));
      return;
    }
  
    String strID = "";
    for (byte i = 0; i < 4; i++) {
      strID +=
      (rfid.uid.uidByte[i] < 0x10 ? "0" : "") +
      String(rfid.uid.uidByte[i], HEX) +
      (i!=3 ? ":" : "");
    }
    strID.toUpperCase();
  
    Serial.print("Tap card key: ");
    Serial.println(strID);
    
    if (strID.indexOf("70:82:41:A8") >= 0) {
      dem = dem + 1; }
      if (dem >= 2) dem=0;
    if (dem  == 1 ) {
        digitalWrite(4,HIGH);
        digitalWrite(3,LOW);
        delay(10000);
        digitalWrite(3,LOW);
        digitalWrite(4,LOW);
        
    }
    else {
        digitalWrite(3,HIGH);
        digitalWrite(4,LOW);
        delay(10000);
        digitalWrite(4,LOW);
        digitalWrite(3,LOW);
        
    }
    
  
    rfid.PICC_HaltA();
    rfid.PCD_StopCrypto1();
    
}

void HumMeter(float* hum, float* temp, int* gas)
{
    u8g.setFont(u8g_font_fub11);
    u8g.setFontRefHeightExtendedText();
    u8g.setDefaultForegroundColor();
    u8g.setFontPosTop();
    u8g.drawStr(4, 0, "Hum % :");
    u8g.setPrintPos(85, 0);
    u8g.print(*hum);
  //#ifdef METRIC
    // if metric system, display Celsius
    u8g.drawStr(4, 20, "Temp *C :");
  //#else
    //display Farenheit
    //u8g.drawStr(4, 20, "Temp F");
  //#endif
  
    u8g.setPrintPos(85, 20);
    u8g.print(*temp);
    u8g.drawStr(4, 40, "Gas PPM :");
    u8g.setPrintPos(90, 40);
    u8g.print(*gas);
}
